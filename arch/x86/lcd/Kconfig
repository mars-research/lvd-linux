## arch/x86/lcd/Kconfig
```kconfig
#
# LCD configuration
#

config LCD
	tristate "Light-weight Capability Domain"
	depends on X86_64
	default y
	---help---
	Light-weight Capability Domain, based on
	Intel VT-x on 64bit X86 CPUs.
```

## arch/x86/lcdguest/Kconfig
```kconfig
config LCD_GUEST
	bool "LCD guest (paravirtual Linux on LCD) support"
	default n
    depends on X86_64
	help
	  Selecting this will allow your kernel to boot under lcd. 
```

## drivers/lcd-cspace/Kconfig
```kconfig
#
# LCD cspace
#

config LCD_CSPACE
       bool "LCD CSPACE"
       default y
       ---help---
       LCD Cspace implementation
```

## drivers/lcd-prototype/Kconfig
```kconfig
#
# LCD prototype
#

config LCD_PROTOTYPE
       bool "LCD Prototype"
       default y
       ---help---
       Prototype for Lightweight Capability Domains system.

config LCD_PROTOTYPE_API
       tristate "LCD Prototype API"
       default m
       depends on LCD_PROTOTYPE
       ---help---
       The kernel prototype for the LCD system.

config LCD_PROTOTYPE_LIBLCD
       tristate "LCD Prototype LibLCD"
       default m
       depends on LCD_PROTOTYPE
       ---help---
       Routines used by test modules.

config LCD_PROTOTYPE_TEST
       tristate "LCD Prototype Test"
       default m
       depends on LCD_PROTOTYPE_API
       depends on LCD_PROTOTYPE_LIBLCD
       select LCD_PROTOTYPE_TEST_BOOT
       select LCD_PROTOTYPE_TEST_CUSTOMER
       select LCD_PROTOTYPE_TEST_DEALER
       select LCD_PROTOTYPE_TEST_MANUFACTURER

config LCD_PROTOTYPE_TEST_CUSTOMER
       tristate
       depends on LCD_PROTOTYPE_TEST
       default m

config LCD_PROTOTYPE_TEST_DEALER
       tristate
       depends on LCD_PROTOTYPE_TEST
       default m

config LCD_PROTOTYPE_TEST_MANUFACTURER
       tristate
       depends on LCD_PROTOTYPE_TEST
       default m

config LCD_PROTOTYPE_TEST_BOOT
       tristate
       depends on LCD_PROTOTYPE_TEST
       depends on LCD_PROTOTYPE_TEST_CUSTOMER
       depends on LCD_PROTOTYPE_TEST_MANUFACTURER
       depends on LCD_PROTOTYPE_TEST_DEALER
       default m

config LCD_PROTOTYPE_TEST_IN_LCD
       bool "LCD Prototype run tests in LCD"
       depends on LCD_PROTOTYPE_TEST
       default false
```

## drivers/lcd/Kconfig
```kconfig
#
# LCD modules configuration
#

config LCD_DRIVERS
       bool "Misc drivers for testing LCDs"
       default y
       ---help---
       Misc drivers for testing Lightweight cap domains.
       
config LCD_PING_PONG_RECEIVER
       tristate "LCD ping-pong IPC test (receiver)"
       depends on LCD_PING_PONG_SENDER
       depends on LCD_DRIVERS
       default m
       ---help---
       Receiver for the ping-pong LCD IPC test

config LCD_PING_PONG_SENDER
       tristate "LCD ping-pong IPC test (sender)"
       depends on LCD_DRIVERS
       default m
       ---help---
       Sender for the ping-pong LCD IPC test

# config LCD_CS_INIT
#        tristate "LCD client-server test (init module)"
#        depends on LCD_CS_CLIENT
#        depends on LCD_CS_SERVER
#        depends on LCD
#        default m
#        ---help---
#        Init code to start the LCD client-server test

# config LCD_CS_CLIENT
#        tristate "LCD client-server test (client)"
#        depends on LCD
#        default m
#        ---help---
#        Client module for the LCD client-server test

# config LCD_CS_SERVER
#        tristate "LCD client-server test (server)"
#        depends on LCD
#        default m
#        ---help---
#        Server module for the LCD client-server test

config LCD_IPC_AUTO
       bool "Build automobile ipc test"
       depends on LCD_DRIVERS

config LCD_AUTO_CUSTOMER
       tristate "LCD automobile ipc test (customer)"
       depends on LCD_IPC_AUTO
       default m
       ---help---
       Auto customer module for ipc test

config LCD_AUTO_DEALER
       tristate "LCD automobile ipc test (dealer)"
       depends on LCD_IPC_AUTO
       default m
       ---help---
       Auto dealer module for ipc test

config LCD_AUTO_MANUFACTURER
       tristate "LCD automobile ipc test (manufacturer)"
       depends on LCD_IPC_AUTO
       default m
       ---help---
       Auto manufacturer module for ipc test

config RUN_IN_LCD
       bool "Run automobile ipc test modules in LCDs"
       depends on LCD_IPC_AUTO
       default false
       ---help---
       Set to true to run ipc auto modules in lcds.
```

## fs/minix-lcd/Kconfig
```kconfig
config MINIX_FS_LCD
	tristate "Minix file system in LCD"
	depends on BLOCK
	help
	  Implementation of Minix FS inside LCD
	
config MINIX_FS_LCD_NATIVE_ENDIAN
	def_bool MINIX_FS_LCD
	depends on H8300 || M32R || MICROBLAZE || MIPS || S390 || SUPERH || SPARC || XTENSA || (M68K && !MMU)

config MINIX_FS_LCD_BIG_ENDIAN_16BIT_INDEXED
	def_bool MINIX_FS_LCD
	depends on M68K && MMU
```

## lib/thc/Kconfig
```kconfig
#
# LCD ASYNC
#

config LAZY_THC
       bool "CONFIG LAZY THC"
       default y
       ---help---
       LAZY ASYNC Implementation
```

## virt/lcd-domains/Kconfig
```kconfig
#
# LCD configuration
#

config LCD_DOMAINS
       tristate "Light-weight Capability Domains"
       depends on X86_64
       select HAVE_LCD
       select TEST_MOD
       default m
       ---help---
       Light-weight Capability Domains for Linux.

config HAVE_LCD
       bool

config LCD_DOMAINS_TESTS
       tristate "Tests of Light-weight Capability Domains"
       depends on LCD_DOMAINS
       default m
       ---help---
       Simple unit tests for lcd domains. Loading the module runs the tests.

menuconfig LCD_TEST_MOD
	   bool "Test Modules"
	   default y
	   ---help---
	   Test modules for LCDs.

if LCD_TEST_MOD

# --------------------------------------------------

config LCD_TEST_MOD_LOAD
       bool "Basic load test with infinite loop"
       depends on LCD_DOMAINS
       default y
       select LCD_TEST_MOD_LOAD_BOOT
       select LCD_TEST_MOD_LOAD_LCD
       ---help---
       Simple infinite loop - don't run outside lcd, it never quits!

config LCD_TEST_MOD_LOAD_BOOT
       tristate
       depends on LCD_TEST_MOD_LOAD
       default m

config LCD_TEST_MOD_LOAD_LCD
       tristate
       depends on LCD_TEST_MOD_LOAD
       default m

# --------------------------------------------------

config LCD_TEST_MOD_LIBLCD_TESTS
       bool "Tests for liblcd"
       depends on LCD_DOMAINS
       default y
       select LCD_TEST_MOD_LIBLCD_TESTS_BOOT
       select LCD_TEST_MOD_LIBLCD_TESTS_LCD
       ---help---
       Tests for code in liblcd - page allocator, kmalloc, etc.

config LCD_TEST_MOD_LIBLCD_TESTS_BOOT
       tristate
       depends on LCD_TEST_MOD_LIBLCD_TESTS
       default m

config LCD_TEST_MOD_LIBLCD_TESTS_LCD
       tristate
       depends on LCD_TEST_MOD_LIBLCD_TESTS
       default m

# --------------------------------------------------

config LCD_TEST_MOD_IPC1
       bool "IPC test with 1 LCD"
       depends on LCD_DOMAINS
       default y
       select LCD_TEST_MOD_IPC1_BOOT
       select LCD_TEST_MOD_IPC1_LCD
       ---help---
       Simple send/recv test with one lcd and one non-isolated module.

config LCD_TEST_MOD_IPC1_BOOT
       tristate
       depends on LCD_TEST_MOD_IPC1
       default m

config LCD_TEST_MOD_IPC1_LCD
       tristate
       depends on LCD_TEST_MOD_IPC1
       default m

# --------------------------------------------------

config LCD_TEST_MOD_IPC2
       bool "IPC test with 2 LCDs"
       depends on LCD_DOMAINS
       default y
       select LCD_TEST_MOD_IPC2_BOOT
       select LCD_TEST_MOD_IPC2_LCD1
       select LCD_TEST_MOD_IPC2_LCD2
       ---help---
       Simple send/recv test with two lcd's and one non-isolated module.
     
config LCD_TEST_MOD_IPC2_BOOT
       tristate
       depends on LCD_TEST_MOD_IPC2
       default m

config LCD_TEST_MOD_IPC2_LCD1
       tristate
       depends on LCD_TEST_MOD_IPC2
       default m

config LCD_TEST_MOD_IPC2_LCD2
       tristate
       depends on LCD_TEST_MOD_IPC2
       default m

# --------------------------------------------------

config LCD_TEST_MOD_CREATE_KLCD
       bool "Create and load a klcd example"
       depends on LCD_DOMAINS
       default y
       select LCD_TEST_MOD_CREATE_KLCD_BOOT
       select LCD_TEST_MOD_CREATE_KLCD_KLCD
       ---help---
       Simple example showing how to load a kLCD.
     
config LCD_TEST_MOD_CREATE_KLCD_BOOT
       tristate
       depends on LCD_TEST_MOD_CREATE_KLCD
       default m

config LCD_TEST_MOD_CREATE_KLCD_KLCD
       tristate
       depends on LCD_TEST_MOD_CREATE_KLCD
       default m

# --------------------------------------------------

endif
```

## virt/lcd/Kconfig
```kconfig
#
# LCD configuration
#

config LCD_DOMAINS
       tristate "Light-weight Capability Domains"
       depends on X86_64
       depends on LCD_INTEL
       default y
       ---help---
       Light-weight Capability Domains for Linux.

config LCD_INTEL
       tristate "Intel support for LCDs"
       depends on X86_64
       default y
       ---help---
       Intel-specific code for usings LCDs.
```
