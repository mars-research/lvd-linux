#include <liblcd/trampoline_link.h>

SECTIONS{
	LCD_TRAMPOLINE_LINKER_SECTION(trmp_devnode)
	LCD_TRAMPOLINE_LINKER_SECTION(trmp_llseek)
	LCD_TRAMPOLINE_LINKER_SECTION(trmp_msr_read)
	LCD_TRAMPOLINE_LINKER_SECTION(trmp_msr_write)
	LCD_TRAMPOLINE_LINKER_SECTION(trmp_msr_ioctl)
	LCD_TRAMPOLINE_LINKER_SECTION(trmp_msr_open)
}

INSERT AFTER .text
